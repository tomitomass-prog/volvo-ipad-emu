#include <stdint.h>
#include <string.h>

#include "esp_err.h"
#include "esp_log.h"
#include "freertos/FreeRTOS.h"
#include "freertos/task.h"
#include "tusb.h"
#include "tinyusb.h"

/* Diagnostic only: one USB HID keyboard interface, no USB Audio, no Apple iAP.
   No keystrokes are generated by this firmware. */
#define DIAG_USB_VID 0xCAFE
#define DIAG_USB_PID 0x4007
#define DIAG_EP_HID_IN 0x81
#define DIAG_HID_ITF 0
#define DIAG_TOTAL_LEN (TUD_CONFIG_DESC_LEN + TUD_HID_DESC_LEN)

static const char *TAG = "S3_HID_DIAG";

static const tusb_desc_device_t dev_desc = {
    .bLength = sizeof(tusb_desc_device_t),
    .bDescriptorType = TUSB_DESC_DEVICE,
    .bcdUSB = 0x0200,
    .bDeviceClass = 0x00,
    .bDeviceSubClass = 0x00,
    .bDeviceProtocol = 0x00,
    .bMaxPacketSize0 = 64,
    .idVendor = DIAG_USB_VID,
    .idProduct = DIAG_USB_PID,
    .bcdDevice = 0x0100,
    .iManufacturer = 1,
    .iProduct = 2,
    .iSerialNumber = 3,
    .bNumConfigurations = 1,
};

static const uint8_t report_desc[] = {
    TUD_HID_REPORT_DESC_KEYBOARD()
};

static const uint8_t config_desc[] = {
    TUD_CONFIG_DESCRIPTOR(1, 1, 0, DIAG_TOTAL_LEN, 0, 100),
    TUD_HID_DESCRIPTOR(DIAG_HID_ITF, 4, HID_ITF_PROTOCOL_KEYBOARD,
                       sizeof(report_desc), DIAG_EP_HID_IN, 16, 10),
};

_Static_assert(sizeof(config_desc) == DIAG_TOTAL_LEN, "HID configuration descriptor size mismatch");

static const char *const string_desc[] = {
    (const char[]){0x09, 0x04},
    "ESP32 Diagnostic",
    "ESP32-S3 USB HID Test v0.7",
    "S3HIDDIAG07",
    "Diagnostic HID Keyboard",
};

uint8_t const *tud_hid_descriptor_report_cb(uint8_t instance)
{
    (void)instance;
    return report_desc;
}

uint16_t tud_hid_get_report_cb(uint8_t instance, uint8_t report_id,
                                hid_report_type_t report_type,
                                uint8_t *buffer, uint16_t reqlen)
{
    (void)instance;
    (void)report_id;
    if (report_type != HID_REPORT_TYPE_INPUT || reqlen < 8) {
        return 0;
    }
    memset(buffer, 0, 8); /* Keyboard idle state, all keys released. */
    return 8;
}

void tud_hid_set_report_cb(uint8_t instance, uint8_t report_id,
                           hid_report_type_t report_type,
                           uint8_t const *buffer, uint16_t bufsize)
{
    (void)instance;
    (void)report_id;
    (void)report_type;
    (void)buffer;
    (void)bufsize;
}

void app_main(void)
{
    const tinyusb_config_t cfg = {
        .device_descriptor = &dev_desc,
        .configuration_descriptor = config_desc,
        .string_descriptor = (char const **)string_desc,
        .string_descriptor_count = sizeof(string_desc) / sizeof(string_desc[0]),
        .external_phy = false,
    };

    ESP_LOGI(TAG, "Starting USB HID-only diagnostic (VID=%04X PID=%04X)",
             DIAG_USB_VID, DIAG_USB_PID);
    ESP_ERROR_CHECK(tinyusb_driver_install(&cfg));
    ESP_LOGI(TAG, "TinyUSB started; waiting for host to configure device");

    bool last = false;
    while (true) {
        const bool mounted = tud_mounted();
        if (mounted != last) {
            ESP_LOGI(TAG, "USB configured: %s", mounted ? "YES" : "NO");
            last = mounted;
        }
        vTaskDelay(pdMS_TO_TICKS(500));
    }
}
